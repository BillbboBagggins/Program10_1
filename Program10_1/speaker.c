//------------------------------------------------------------------------------
//             __             __   ___  __
//     | |\ | /  ` |    |  | |  \ |__  /__`
//     | | \| \__, |___ \__/ |__/ |___ .__/
//
//------------------------------------------------------------------------------

#include "speaker.h"

//------------------------------------------------------------------------------
//      __   ___  ___         ___  __
//     |  \ |__  |__  | |\ | |__  /__`
//     |__/ |___ |    | | \| |___ .__/
//
//------------------------------------------------------------------------------
#include "sam.h"

//------------------------------------------------------------------------------
//     ___      __   ___  __   ___  ___  __
//      |  \ / |__) |__  |  \ |__  |__  /__`
//      |   |  |    |___ |__/ |___ |    .__/
//
//------------------------------------------------------------------------------

//------------------------------------------------------------------------------
//                __          __        ___  __
//     \  /  /\  |__) |  /\  |__) |    |__  /__`
//      \/  /~~\ |  \ | /~~\ |__) |___ |___ .__/
//
//------------------------------------------------------------------------------

//------------------------------------------------------------------------------
//      __   __   __  ___  __  ___      __   ___  __
//     |__) |__) /  \  |  /  \  |  \ / |__) |__  /__`
//     |    |  \ \__/  |  \__/  |   |  |    |___ .__/
//
//------------------------------------------------------------------------------

//------------------------------------------------------------------------------
//      __        __          __
//     |__) |  | |__) |    | /  `
//     |    \__/ |__) |___ | \__,
//
//------------------------------------------------------------------------------

#include "speaker.h"

void speaker_init(void)
{
	// Enable PORT module clock
	PM->APBBMASK.reg |= PM_APBBMASK_PORT;

	// Enable TCC0 in the Power Manager
	PM->APBCMASK.reg |= PM_APBCMASK_TCC0;

	// Route a generic clock to TCC0
	GCLK->CLKCTRL.reg = GCLK_CLKCTRL_ID_TCC0_TCC1 |
	GCLK_CLKCTRL_GEN_GCLK0 |
	GCLK_CLKCTRL_CLKEN;
	while (GCLK->STATUS.bit.SYNCBUSY);

	// Configure PA09 mux to Peripheral Function E (TCC0/WO1)
	PORT->Group[0].PINCFG[9].bit.PMUXEN = 1;
	PORT->Group[0].PMUX[9 >> 1].bit.PMUXO = MUX_PA09E_TCC0_WO1;

	// Reset TCC0
	TCC0->CTRLA.bit.SWRST = 1;
	while (TCC0->SYNCBUSY.bit.SWRST);

	// Configure TCC0 for normal PWM
	TCC0->WAVE.bit.WAVEGEN = TCC_WAVE_WAVEGEN_NPWM;
	while (TCC0->SYNCBUSY.bit.WAVE);

	// Default period and duty cycle
	TCC0->PER.reg = 48000 - 1;   // ~1 kHz at 48 MHz clock
	while (TCC0->SYNCBUSY.bit.PER);

	TCC0->CC[1].reg = 24000;     // 50% duty
	while (TCC0->SYNCBUSY.bit.CC1);

	// Enable TCC0
	TCC0->CTRLA.bit.ENABLE = 1;
	while (TCC0->SYNCBUSY.bit.ENABLE);
}

void speaker_set_duty(uint16_t duty)
{
	TCC0->CC[1].reg = duty;
	while (TCC0->SYNCBUSY.bit.CC1);
}

void speaker_set_period(uint16_t period)
{
	TCC0->PER.reg = period;
	while (TCC0->SYNCBUSY.bit.PER);
}




//==============================================================================
//------------------------------------------------------------------------------
//      __   __              ___  ___
//     |__) |__) | \  /  /\   |  |__
//     |    |  \ |  \/  /~~\  |  |___
//
//------------------------------------------------------------------------------

//------------------------------------------------------------------------------
//      __                  __        __        __
//     /  `  /\  |    |    |__)  /\  /  ` |__/ /__`
//     \__, /~~\ |___ |___ |__) /~~\ \__, |  \ .__/
//
//------------------------------------------------------------------------------

//------------------------------------------------------------------------------
//        __   __  , __
//     | /__` |__)  /__`   
//     | .__/ |  \  .__/
//
//------------------------------------------------------------------------------
